## sdkconfig.defaults
```kconfig
# ============================================================
# FakePod Nano
# ESP32-S3R8 + external 16MB Quad Flash
# ============================================================

# CPU 240MHz
CONFIG_ESP_DEFAULT_CPU_FREQ_MHZ_240=y
CONFIG_ESP_DEFAULT_CPU_FREQ_MHZ=240

# ------------------------------------------------------------
# 编译优化
# 正式固件使用性能优化；保留断言，避免为了性能牺牲运行期错误检查。
# ------------------------------------------------------------
CONFIG_COMPILER_OPTIMIZATION_PERF=y
CONFIG_COMPILER_OPTIMIZATION_ASSERTIONS_ENABLE=y

# ------------------------------------------------------------
# External SPI Flash
# 原厂固件：DIO / 80MHz / 16MB
# ------------------------------------------------------------
CONFIG_ESPTOOLPY_FLASHMODE_DIO=y
CONFIG_ESPTOOLPY_FLASHFREQ_80M=y
CONFIG_ESPTOOLPY_FLASHSIZE_16MB=y

# ------------------------------------------------------------
# Embedded PSRAM
# ESP32-S3R8: 8MB Octal PSRAM
# ------------------------------------------------------------
CONFIG_SPIRAM=y
CONFIG_SPIRAM_MODE_OCT=y
CONFIG_SPIRAM_TYPE_AUTO=y
CONFIG_SPIRAM_SPEED_80M=y
CONFIG_SPIRAM_BOOT_INIT=y

# malloc() 可以使用 PSRAM
CONFIG_SPIRAM_USE_MALLOC=y

# 小内存优先使用内部 RAM
CONFIG_SPIRAM_MALLOC_ALWAYSINTERNAL=16384

# 给 DMA / cache / driver 保留内部 RAM
CONFIG_SPIRAM_MALLOC_RESERVE_INTERNAL=32768
CONFIG_FATFS_LFN_HEAP=y
CONFIG_FATFS_MAX_LFN=255
CONFIG_FATFS_API_ENCODING_UTF_8=y

# R.40 Video V1：esp_extractor 只保留 AVI，避免无关容器增加固件体积。
CONFIG_EXTRACTOR_CUSTOM_SUPPORT=n
CONFIG_WAV_EXTRACTOR_SUPPORT=n
CONFIG_MP4_EXTRACTOR_SUPPORT=n
CONFIG_TS_EXTRACTOR_SUPPORT=n
CONFIG_OGG_EXTRACTOR_SUPPORT=n
CONFIG_AVI_EXTRACTOR_SUPPORT=y
CONFIG_AUDIO_ES_EXTRACTOR_SUPPORT=n
CONFIG_CAF_EXTRACTOR_SUPPORT=n
CONFIG_FLV_EXTRACTOR_SUPPORT=n
CONFIG_EXTRACTOR_HELPER_FILE_IO_CACHE_SIZE=4096
# ------------------------------------------------------------
# USB Device / TF Card maintenance mode
# 一次性启动维护模式与 V3.4 运行时热切换共用 TinyUSB MSC + CDC。
# ------------------------------------------------------------
CONFIG_TINYUSB_MSC_ENABLED=y
CONFIG_TINYUSB_MSC_BUFSIZE=8192
CONFIG_TINYUSB_CDC_ENABLED=y
CONFIG_TINYUSB_CDC_COUNT=1
CONFIG_TINYUSB_CDC_RX_BUFSIZE=512
CONFIG_TINYUSB_CDC_TX_BUFSIZE=512
CONFIG_TINYUSB_CDC_EP_BUFSIZE=512
CONFIG_TINYUSB_DESC_MANUFACTURER_STRING="FakePod"
CONFIG_TINYUSB_DESC_PRODUCT_STRING="FakePod USB Service"
CONFIG_TINYUSB_DESC_MSC_STRING="FakePod TF Card"
CONFIG_TINYUSB_DESC_CDC_STRING="FakePod Serial"
```
